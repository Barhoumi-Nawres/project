## meta-rpi-bsp/conf/machine/rpi0-2w.conf
```bitbake
#@TYPE: Machine
#@NAME: rpi0-2w.conf
#@DESCRIPTION: Raspberrypi02w BCM2710A1 ,SOC 64 bits , 512Mo RAM,wifi ,bluetooth 

MACHINEOVERRIDES =. "rasberry0-2w-64:"
require conf/machine/raspberrypi0-2w-64.conf

TUNE_PKGARCH = "cortexa53"

#Target machine 
TARGET_ARCH = "aarch64"

#Machine features
MACHINE_FEATURES = "apm usbhost vfat ext2 wifi sdio"

# Kernel
PREFERRED_PROVIDER_virtual/kernel ?= "linux-raspberrypi"

#Output of the kernel zimage .
KERNEL_IMAGETYPE ?= "zImage"

# Remove  kernel image from  rootfs
RDEPENDS_${KERNEL_PACKAGE_NAME}-base = ""

#enable uart 
ENABLE_UART ="1"

#Type of the image 
IMAGE_FSTYPES = "wic"
```
