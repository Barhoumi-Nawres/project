## meta-rpi-bsp/conf/layer.conf
```bitbake
# We have a conf and classes directory, add to BBPATH
BBPATH .= ":${LAYERDIR}"

# We have recipes-* directories, add to BBFILES
BBFILES += "${LAYERDIR}/recipes-*/*/*.bb \
            ${LAYERDIR}/recipes-*/*/*.bbappend"

BBFILE_COLLECTIONS += "meta-rpi-bsp"
BBFILE_PATTERN_meta-rpi-bsp = "^${LAYERDIR}/"
BBFILE_PRIORITY_meta-rpi-bsp = "6"

LAYERDEPENDS_meta-rpi-bsp = "core"
LAYERSERIES_COMPAT_meta-rpi-bsp = "scarthgap"
```

## meta-rpi-distro/conf/layer.conf
```bitbake
# We have a conf and classes directory, add to BBPATH
BBPATH .= ":${LAYERDIR}"

# We have recipes-* directories, add to BBFILES
BBFILES += "${LAYERDIR}/recipes-*/*/*.bb \
            ${LAYERDIR}/recipes-*/*/*.bbappend"

BBFILE_COLLECTIONS += "meta-rpi-distro"
BBFILE_PATTERN_meta-rpi-distro = "^${LAYERDIR}/"
BBFILE_PRIORITY_meta-rpi-distro = "6"

LAYERDEPENDS_meta-rpi-distro = "core"
LAYERSERIES_COMPAT_meta-rpi-distro = "scarthgap"
```

## meta-rpi-prj/conf/layer.conf
```bitbake
# We have a conf and classes directory, add to BBPATH
BBPATH .= ":${LAYERDIR}"

# We have recipes-* directories, add to BBFILES
BBFILES += "${LAYERDIR}/recipes-*/*/*.bb \
            ${LAYERDIR}/recipes-*/*/*.bbappend"

BBFILE_COLLECTIONS += "meta-rpi-prj"
BBFILE_PATTERN_meta-rpi-prj = "^${LAYERDIR}/"
BBFILE_PRIORITY_meta-rpi-prj = "6"

LAYERDEPENDS_meta-rpi-prj = "core"
LAYERSERIES_COMPAT_meta-rpi-prj = "scarthgap"
```
